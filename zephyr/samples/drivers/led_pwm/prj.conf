## CMakeLists.txt
```
# SPDX-License-Identifier: Apache-2.0

cmake_minimum_required(VERSION 3.20.0)

find_package(Zephyr HINTS $ENV{ZEPHYR_BASE})
project(led_gpio)

FILE(GLOB app_sources src/*.c)
target_sources(app PRIVATE ${app_sources})
```

## Kconfig
```
# Copyright (c) 2022 tangchunhui@coros.com
# SPDX-License-Identifier: Apache-2.0

source "Kconfig.zephyr"

config FS_DEVFS_CHDEV_LED
	bool "Change zephyr led device to devfs character device"
	depends on FS_DEVFS_CHDEV && LED
	default n
```

## sample.yaml
```
sample:
  description: Demonstration of the PWM LED device
  name: PWM LED sample
tests:
  sample.drivers.led.led_pwm:
    filter: dt_compat_enabled("pwm-leds")
    tags: LED
    depends_on: PWM
```

## prj.conf
```kconfig
CONFIG_LOG=y

CONFIG_FILE_SYSTEM=y
CONFIG_FILE_SYSTEM_DEVFS=y
CONFIG_FS_DEVFS_CHDEV=y
CONFIG_FS_DEVFS_CHDEV_LED=y

CONFIG_POSIX_API=y
CONFIG_POSIX_FS=y

CONFIG_PWM=y

CONFIG_LED=y
CONFIG_LED_PWM=y
```

## src/main.c
```c
/*
 * Copyright (c) 2022 tangchunhui@coros.com
 *
 * SPDX-License-Identifier: Apache-2.0
 */

#include <fcntl.h>
#include <unistd.h>
#include <sys/stat.h>
#include <sys/types.h>

#include "devfs.h"

#define LED_NAME	"/dev/pwmleds"

int ioctl(int fd, unsigned long request, ...);

void main(void)
{
    int led = 0;
    int ret = 0;

    led = open(LED_NAME, O_RDWR);
    if (led < 0) {
        printk("open(%s) fail \r\n", LED_NAME);
        return;
    }

    while (1) {
        struct led_brightness config;

        config.led = 0;

        for (int brightness = 0; brightness <= 100; brightness++)
        {
            config.brightness = brightness;

            ret = ioctl(led, LEDIOC_SET_BRIGHTNESS, &config);

            k_sleep(K_MSEC(10));
        }

        for (int brightness = 100; brightness >= 0; brightness--)
        {
            config.brightness = brightness;

            ret = ioctl(led, LEDIOC_SET_BRIGHTNESS, &config);

            k_sleep(K_MSEC(10));
        }
    }

    close(led);
    printk("close(%s) OK \r\n", LED_NAME);
}
```
